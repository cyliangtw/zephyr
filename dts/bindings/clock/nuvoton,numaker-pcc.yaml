## dts/bindings/clock/nuvoton,numaker-pcc.yaml
```yaml
# Copyright (c) 2022 Nuvoton Technology Corporation
# SPDX-License-Identifier: Apache-2.0

description: Nuvoton NuMaker Peripheral Clock Controller (PCC)

compatible: "nuvoton,numaker-pcc"

include: [clock-controller.yaml, base.yaml]

properties:
    "#clock-cells":
      const: 3

clock-cells:
  - clock-module-index
  - clock-source
  - clock-divider
```

## dts/bindings/clock/nuvoton,numaker-scc.yaml
```yaml
# Copyright (c) 2022 Nuvoton Technology Corporation
# SPDX-License-Identifier: Apache-2.0

description: Nuvoton NuMaker System Clock Controller (SCC)

compatible: "nuvoton,numaker-scc"

include: [clock-controller.yaml, base.yaml]

properties:
    reg:
      required: true

    hxt:
      type: string
      required: false
      description: |
        Enable/disable 4~24 MHz external crystal oscillator (HXT)
      enum:
        - "untouched"
        - "enable"
        - "disable"

    lxt:
      type: string
      required: false
      description: |
        Enable/disable 32.768 kHz low-speed external crystal oscillator (LXT)
      enum:
        - "untouched"
        - "enable"
        - "disable"

    hirc:
      type: string
      required: false
      description: |
        Enable/disable 12 MHz high-speed internal RC oscillator (HIRC)
      enum:
        - "untouched"
        - "enable"
        - "disable"

    lirc:
      type: string
      required: false
      description: |
        Enable/disable 10 KHz low-speed internal rc oscillator (LIRC)
      enum:
        - "untouched"
        - "enable"
        - "disable"

    hirc48:
      type: string
      required: false
      description: |
        Enable/disable 48 MHz high-speed internal RC oscillator (HIRC48)
      enum:
        - "untouched"
        - "enable"
        - "disable"

    clk-pclkdiv:
      type: int
      required: false
      description: |
          Configure APB Clock Divider register

    core-clock:
      type: int
      required: false
      description: |
          Configure core clock (HCLK)
```
